## conf/layer.conf
```bitbake
# We have a conf and classes directory, add to BBPATH
BBPATH .= ":${LAYERDIR}"

# We have recipes-* directories, add to BBFILES
BBFILES += "${LAYERDIR}/recipes-*/*/*.bb \
            ${LAYERDIR}/recipes-*/*/*.bbappend"

BBFILE_COLLECTIONS += "meta-kernel-filter-cve"
BBFILE_PATTERN_meta-kernel-filter-cve = "^${LAYERDIR}/"
BBFILE_PRIORITY_meta-kernel-filter-cve = "9"

LAYERDEPENDS_meta-kernel-filter-cve = "core"
LAYERSERIES_COMPAT_meta-kernel-filter-cve = "scarthgap"

# Inherit cve-check to generate CVE reports
INHERIT += "cve-check"
include conf/distro/include/cve-extra-exclusions.inc
```
